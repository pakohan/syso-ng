## V6/packages/Config.in
```kconfig
config BR2_PACKAGE_USERPROG
	bool "userprog"
	help
	  This aren't the droids you're looking for.

	  http://www.google.com/

config BR2_PACKAGE_USERPROG_STATIC
	bool "compile static"
	depends on BR2_PACKAGE_USERPROG
	help
	  This aren't the droids you're looking for.

	  http://www.google.com/
```

## V6/packages/progs/Config.in
```kconfig
config BR2_PACKAGE_PROGS
        bool "progs"
        help
          This aren't the droids you're looking for.

          http://www.google.com/
```
